## arch/arm/src/rm57/Kconfig
```kconfig
#
# For a description of the syntax of this configuration file,
# see the file kconfig-language.txt in the NuttX tools repository.
#

if ARCH_CHIP_RM57

comment "RM57 Configuration Options"

# Chip Selection

choice
	prompt "TI Hercules RM57 Chip Selection"
	default ARCH_CHIP_RM57L843

config ARCH_CHIP_RM57L843
	bool "TI RM57L843"
	select ARCH_CORTEXR5
	select ARCH_HAVE_FPU

endchoice # TI Hercules RM57 Chip Selection

menu "RM57 Peripheral Support"

config RM57_SCI1
	bool "Serial Communication Interface 1 (SCI1/LIN1, SCI-compatibility mode)"
	default n
	select SCI1_SERIALDRIVER
	select ARCH_HAVE_SERIAL_TERMIOS

config RM57_SCI2
	bool "Serial Communication Interface 2 (SCI2/LIN2, SCI-compatibility mode)"
	default n
	select SCI2_SERIALDRIVER
	select ARCH_HAVE_SERIAL_TERMIOS

config RM57_SCI3
	bool "Serial Communication Interface 3 (SCI3)"
	default n
	select SCI3_SERIALDRIVER
	select ARCH_HAVE_SERIAL_TERMIOS

config RM57_SCI4
	bool "Serial Communication Interface 4 (SCI4)"
	default n
	select SCI4_SERIALDRIVER
	select ARCH_HAVE_SERIAL_TERMIOS

config RM57_DMA
	bool "DMA controller (32-channel, 48 request lines)"
	default n
	---help---
		Enable the general-purpose DMA controller driver. Required by the
		RM57_SCIn_RXDMA/TXDMA serial DMA options.

config RM57_SCI1_RXDMA
	bool "SCI1/LIN1 receive DMA"
	default n
	depends on RM57_SCI1 && RM57_DMA
	select SERIAL_RXDMA

config RM57_SCI1_TXDMA
	bool "SCI1/LIN1 transmit DMA"
	default n
	depends on RM57_SCI1 && RM57_DMA
	select SERIAL_TXDMA

config RM57_SCI2_RXDMA
	bool "SCI2/LIN2 receive DMA"
	default n
	depends on RM57_SCI2 && RM57_DMA
	select SERIAL_RXDMA

config RM57_SCI2_TXDMA
	bool "SCI2/LIN2 transmit DMA"
	default n
	depends on RM57_SCI2 && RM57_DMA
	select SERIAL_TXDMA

config RM57_SCI3_RXDMA
	bool "SCI3 receive DMA"
	default n
	depends on RM57_SCI3 && RM57_DMA
	select SERIAL_RXDMA

config RM57_SCI3_TXDMA
	bool "SCI3 transmit DMA"
	default n
	depends on RM57_SCI3 && RM57_DMA
	select SERIAL_TXDMA

config RM57_SCI4_RXDMA
	bool "SCI4 receive DMA"
	default n
	depends on RM57_SCI4 && RM57_DMA
	select SERIAL_RXDMA

config RM57_SCI4_TXDMA
	bool "SCI4 transmit DMA"
	default n
	depends on RM57_SCI4 && RM57_DMA
	select SERIAL_TXDMA

config RM57_LIN
	bool "LIN 2.x driver scaffold (LIN1/LIN2 modules)"
	default n
	depends on EXPERIMENTAL
	---help---
		Configuration and polled transfer foundation for LIN-mode
		operation of the SCI1/LIN1 and SCI2/LIN2 dual-role modules (see
		rm57_lin.h). Not integrated with the serial upper half, and not
		a complete LIN protocol stack - see rm57_lin.h for what is and
		is not implemented.

		A LIN module cannot be used simultaneously in SCI mode
		(RM57_SCI1/RM57_SCI2) and LIN mode; this is a runtime choice,
		not enforced here, since e.g. SCI1 could run in SCI mode while
		SCI2/LIN2 runs in LIN mode.

config RM57_SERIAL_RXDMA_BUFFER_SIZE
	int "RX DMA buffer size"
	default 64
	depends on RM57_SCI1_RXDMA || RM57_SCI2_RXDMA || RM57_SCI3_RXDMA || \
		RM57_SCI4_RXDMA
	---help---
		The DMA buffer size when using RX DMA. This buffer is used to
		receive data on the SCI while waiting for the application to
		claim it. Rounded up to a multiple of the 32-byte Cortex-R5
		D-cache line size.

config RM57_SERIAL_RXDMA_POLL
	bool "Periodic RX DMA flush"
	default y
	depends on RM57_SCI1_RXDMA || RM57_SCI2_RXDMA || RM57_SCI3_RXDMA || \
		RM57_SCI4_RXDMA
	---help---
		RX DMA hands received bytes to the upper half only when the
		DMA half/full interrupt fires, that is, after half of
		RM57_SERIAL_RXDMA_BUFFER_SIZE bytes. The SCI has no idle-line
		interrupt to signal the end of a shorter burst, so this option
		dedicates RTI compare 1 to calling rm57_serial_dma_poll()
		periodically, which bounds the added receive latency by the
		poll period.

		Leave this enabled unless every RX DMA port is used purely for
		bulk transfers; without it, a short message sits in the ring
		buffer until enough further bytes arrive, and an RX DMA console
		is unusable interactively.

config RM57_SERIAL_RXDMA_POLL_HZ
	int "RX DMA flush frequency (Hz)"
	default 1000
	range 1 100000
	depends on RM57_SERIAL_RXDMA_POLL
	---help---
		How often the RX DMA rings are flushed, in Hz. The worst-case
		added receive latency is one poll period; the cost is one short
		interrupt at this rate, which checks one pointer per enabled
		port and returns when nothing was received.

config RM57_DCAN
	bool
	default n
	---help---
		Hidden umbrella symbol selected by any RM57_DCANn instance;
		pulls the shared DCAN core driver into the build.

menuconfig RM57_DCAN1
	bool "DCAN1 CAN controller"
	default n
	select RM57_DCAN

if RM57_DCAN1

choice
	prompt "DCAN1 driver framework"
	default RM57_DCAN1_CHARDRIVER

config RM57_DCAN1_CHARDRIVER
	bool "Character device driver (/dev/canN)"
	select CAN
	select CAN_TXREADY
	select CAN_USE_RTR
	select ARCH_HAVE_CAN_ERRORS

config RM57_DCAN1_SOCKET
	bool "SocketCAN network driver"
	depends on NET_CAN
	select NET_CAN_HAVE_ERRORS

endchoice # DCAN1 driver framework

config RM57_DCAN1_BAUD
	int "DCAN1 initial bit rate"
	default 500000
	range 1000 1000000

choice
	prompt "DCAN1 RX path"
	default RM57_DCAN1_RX_PIO

config RM57_DCAN1_RX_PIO
	bool "IF2 programmed I/O (interrupt per message)"

config RM57_DCAN1_RX_IF3IRQ
	bool "IF3 auto-update with IF3 interrupt"

config RM57_DCAN1_RX_IF3DMA
	bool "IF3 auto-update with DMA (EXPERIMENTAL)"
	depends on RM57_DMA && EXPERIMENTAL

endchoice # DCAN1 RX path

endif # RM57_DCAN1

menuconfig RM57_DCAN2
	bool "DCAN2 CAN controller"
	default n
	select RM57_DCAN

if RM57_DCAN2

choice
	prompt "DCAN2 driver framework"
	default RM57_DCAN2_CHARDRIVER

config RM57_DCAN2_CHARDRIVER
	bool "Character device driver (/dev/canN)"
	select CAN
	select CAN_TXREADY
	select CAN_USE_RTR
	select ARCH_HAVE_CAN_ERRORS

config RM57_DCAN2_SOCKET
	bool "SocketCAN network driver"
	depends on NET_CAN
	select NET_CAN_HAVE_ERRORS

endchoice # DCAN2 driver framework

config RM57_DCAN2_BAUD
	int "DCAN2 initial bit rate"
	default 500000
	range 1000 1000000

choice
	prompt "DCAN2 RX path"
	default RM57_DCAN2_RX_PIO

config RM57_DCAN2_RX_PIO
	bool "IF2 programmed I/O (interrupt per message)"

config RM57_DCAN2_RX_IF3IRQ
	bool "IF3 auto-update with IF3 interrupt"

config RM57_DCAN2_RX_IF3DMA
	bool "IF3 auto-update with DMA (EXPERIMENTAL)"
	depends on RM57_DMA && EXPERIMENTAL

endchoice # DCAN2 RX path

endif # RM57_DCAN2

menuconfig RM57_DCAN3
	bool "DCAN3 CAN controller"
	default n
	select RM57_DCAN

if RM57_DCAN3

choice
	prompt "DCAN3 driver framework"
	default RM57_DCAN3_CHARDRIVER

config RM57_DCAN3_CHARDRIVER
	bool "Character device driver (/dev/canN)"
	select CAN
	select CAN_TXREADY
	select CAN_USE_RTR
	select ARCH_HAVE_CAN_ERRORS

config RM57_DCAN3_SOCKET
	bool "SocketCAN network driver"
	depends on NET_CAN
	select NET_CAN_HAVE_ERRORS

endchoice # DCAN3 driver framework

config RM57_DCAN3_BAUD
	int "DCAN3 initial bit rate"
	default 500000
	range 1000 1000000

choice
	prompt "DCAN3 RX path"
	default RM57_DCAN3_RX_PIO

config RM57_DCAN3_RX_PIO
	bool "IF2 programmed I/O (interrupt per message)"

config RM57_DCAN3_RX_IF3IRQ
	bool "IF3 auto-update with IF3 interrupt"

config RM57_DCAN3_RX_IF3DMA
	bool "IF3 auto-update with DMA (EXPERIMENTAL)"
	depends on RM57_DMA && EXPERIMENTAL

endchoice # DCAN3 RX path

endif # RM57_DCAN3

menuconfig RM57_DCAN4
	bool "DCAN4 CAN controller"
	default n
	select RM57_DCAN
	---help---
		DCAN4 pins are shared with GIOB[2] (ball F2, CAN4 TX) and
		GIOB[3] (ball W10, CAN4 RX).  The board pinmux claims them for
		CAN when this option is enabled.

if RM57_DCAN4

choice
	prompt "DCAN4 driver framework"
	default RM57_DCAN4_CHARDRIVER

config RM57_DCAN4_CHARDRIVER
	bool "Character device driver (/dev/canN)"
	select CAN
	select CAN_TXREADY
	select CAN_USE_RTR
	select ARCH_HAVE_CAN_ERRORS

config RM57_DCAN4_SOCKET
	bool "SocketCAN network driver"
	depends on NET_CAN
	select NET_CAN_HAVE_ERRORS

endchoice # DCAN4 driver framework

config RM57_DCAN4_BAUD
	int "DCAN4 initial bit rate"
	default 500000
	range 1000 1000000

choice
	prompt "DCAN4 RX path"
	default RM57_DCAN4_RX_PIO

config RM57_DCAN4_RX_PIO
	bool "IF2 programmed I/O (interrupt per message)"

config RM57_DCAN4_RX_IF3IRQ
	bool "IF3 auto-update with IF3 interrupt"

config RM57_DCAN4_RX_IF3DMA
	bool "IF3 auto-update with DMA (EXPERIMENTAL)"
	depends on RM57_DMA && EXPERIMENTAL

endchoice # DCAN4 RX path

endif # RM57_DCAN4

if RM57_DCAN

config RM57_DCAN_TXFIFO_DEPTH
	int "DCAN TX FIFO depth (mailboxes per instance)"
	default 8
	range 1 32
	---help---
		Number of message objects reserved for transmission, taken
		from the top of the 64-mailbox range so that RX filters keep
		the (higher priority) low mailbox numbers.

config RM57_DCAN_RXFIFO_DEPTH
	int "DCAN RX FIFO depth (mailboxes per filter)"
	default 8
	range 1 32
	---help---
		Number of message objects chained (EoB) into the receive FIFO
		of each acceptance filter, including the default catch-all
		filter installed when no user filter is active.

config RM57_DCAN_NFILTERS_MAX
	int "DCAN maximum concurrent acceptance filters"
	default 4
	range 1 8

config RM57_DCAN_IF3_NFRAMES
	int "DCAN IF3 DMA ring size (frames)"
	default 16
	range 2 64
	depends on RM57_DCAN1_RX_IF3DMA || RM57_DCAN2_RX_IF3DMA || \
		RM57_DCAN3_RX_IF3DMA || RM57_DCAN4_RX_IF3DMA

config RM57_DCAN_SECDED
	bool "DCAN message RAM SECDED (ECC)"
	default y
	---help---
		Keep the message RAM single-error-correction/double-error-
		detection logic enabled (CTL.PMD).  Disable only for
		bring-up debugging; parity events are reported through the
		CAN error reporting path when enabled.

config RM57_DCAN_LOOPBACK
	bool "DCAN internal loopback at setup (self-test)"
	default n
	---help---
		Enter internal loopback test mode (TEST.LBack) as part of
		controller setup so the driver can be exercised without a
		transceiver or bus.  Frames are looped back internally; the
		CAN_TX pin stays recessive.  Can also be controlled at
		runtime via CANIOC_SET_CONNMODES.

endif # RM57_DCAN

menuconfig RM57_EMAC
	bool "Ethernet MAC (EMAC/MDIO)"
	default n
	select NETDEVICES
	select ARCH_HAVE_PHY
	select ARCH_HAVE_NETDEV_STATISTICS
	depends on ARCH_CHIP_RM57L843
	---help---
		TI CPSW-lite 10/100 Ethernet MAC, EMAC Control module and
		MDIO module.  There is exactly one EMAC on this device.

if RM57_EMAC

choice
	prompt "PHY interface mode"
	default RM57_EMAC_MII
	---help---
		The LAUNCHXL2-RM57L carries a DP83640 PHY wired for MII; the
		reset default IOMM selection is RMII, so MII must be
		explicitly selected here to match that board.

config RM57_EMAC_MII
	bool "MII"

config RM57_EMAC_RMII
	bool "RMII"
	---help---
		See the BOARD_VCLKA4_* comment in the board's board.h: this
		port does not independently verify the PLL2-derived 50MHz
		clock RMII requires and it should be measured on real
		hardware before relying on this mode.

endchoice # PHY interface mode

config RM57_EMAC_PHYADDR
	int "PHY address"
	default 1
	range 0 31

config RM57_EMAC_NTXDESC
	int "Number of TX descriptors"
	default 8
	range 2 128

config RM57_EMAC_NRXDESC
	int "Number of RX descriptors"
	default 16
	range 2 128

config RM57_EMAC_MDIO_FREQ
	int "MDIO clock (Hz)"
	default 1000000
	range 100000 2500000
	---help---
		SPNU562A Section 31.2.1: typical operation is 1MHz; the MDIO
		module is specified to run up to 2.5MHz.

config RM57_EMAC_AUTONEG
	bool "Autonegotiation"
	default y

config RM57_EMAC_ETHFD
	bool "Full duplex"
	default n
	depends on !RM57_EMAC_AUTONEG

config RM57_EMAC_ETH100MBPS
	bool "100 Mbps"
	default n
	depends on !RM57_EMAC_AUTONEG

config RM57_EMAC_PHY_INTERRUPT
	bool "PHY link-change interrupt (MDIO LINKINT0)"
	default y
	select ARCH_PHY_INTERRUPT
	---help---
		Enables SIOCMIINOTIFY / phy_notify support.  This driver
		always enables the underlying MDIO link-change interrupt for
		its own netdev_carrier_on/off tracking regardless of this
		setting; this option only gates whether a phy_notify
		subscriber can also attach to link events.

config RM57_EMAC_LOOPBACK
	bool "MAC internal loopback at ifup (self-test)"
	default n
	---help---
		Set MACCONTROL.LOOPBACK and skip the PHY link wait entirely,
		so the descriptor ring and interrupt path can be exercised
		standalone without a PHY or cable - the RM57_DCAN_LOOPBACK
		equivalent for Ethernet.

config RM57_EMAC_REGDEBUG
	bool "Register-level debug"
	default n
	depends on DEBUG_NET_INFO

endif # RM57_EMAC

endmenu # RM57 Peripheral Support

endif # ARCH_CHIP_RM57
```
